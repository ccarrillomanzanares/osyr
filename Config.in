## Config.in
```kconfig
# OSYR's own packages. Each new package: package/<name>/Config.in +
# <name>.mk (+ .hash), and a line here.
source "$BR2_EXTERNAL_OSYR_PATH/package/alsa-ucm-conf/Config.in"
source "$BR2_EXTERNAL_OSYR_PATH/package/grim/Config.in"
source "$BR2_EXTERNAL_OSYR_PATH/package/mako/Config.in"
source "$BR2_EXTERNAL_OSYR_PATH/package/noto-emoji/Config.in"
source "$BR2_EXTERNAL_OSYR_PATH/package/sherpa-onnx/Config.in"
source "$BR2_EXTERNAL_OSYR_PATH/package/sof-bin/Config.in"
source "$BR2_EXTERNAL_OSYR_PATH/package/swayidle/Config.in"
source "$BR2_EXTERNAL_OSYR_PATH/package/swaylock/Config.in"
source "$BR2_EXTERNAL_OSYR_PATH/package/whisper-cpp/Config.in"
source "$BR2_EXTERNAL_OSYR_PATH/package/wl-clipboard/Config.in"
source "$BR2_EXTERNAL_OSYR_PATH/package/wl-mirror/Config.in"
source "$BR2_EXTERNAL_OSYR_PATH/package/wtype/Config.in"
```

## package/alsa-ucm-conf/Config.in
```kconfig
config BR2_PACKAGE_ALSA_UCM_CONF
	bool "alsa-ucm-conf"
	depends on BR2_PACKAGE_ALSA_LIB
	help
	  ALSA UCM profiles: they describe how to use each card's speakers,
	  headphones and microphones. Essential with SOF (digital microphones
	  on Intel laptops); PipeWire/WirePlumber use them.

	  https://github.com/alsa-project/alsa-ucm-conf
```

## package/grim/Config.in
```kconfig
config BR2_PACKAGE_GRIM
	bool "grim"
	depends on BR2_PACKAGE_WAYLAND
	select BR2_PACKAGE_PIXMAN
	select BR2_PACKAGE_LIBPNG
	select BR2_PACKAGE_WAYLAND_PROTOCOLS
	help
	  Screenshots on Wayland (sway). Used by the Print Screen key,
	  /look and osyr-diag.

	  https://sr.ht/~emersion/grim/
```

## package/mako/Config.in
```kconfig
config BR2_PACKAGE_MAKO
	bool "mako"
	depends on BR2_PACKAGE_WAYLAND
	depends on BR2_PACKAGE_SYSTEMD
	select BR2_PACKAGE_CAIRO
	select BR2_PACKAGE_PANGO
	select BR2_PACKAGE_WAYLAND_PROTOCOLS
	help
	  Desktop notifications for sway (those from applications and OSYR's
	  own alerts: low battery, updates...).

	  https://github.com/emersion/mako
```

## package/noto-emoji/Config.in
```kconfig
config BR2_PACKAGE_NOTO_EMOJI
	bool "noto-emoji"
	depends on BR2_PACKAGE_FONTCONFIG
	help
	  Noto Color Emoji: colour emoji font (CBDT bitmaps, needs
	  FreeType with PNG). Fontconfig uses it as the fallback for
	  emoji the other fonts lack, so they are not drawn as boxes
	  in the terminal, the bar, notifications and the browser.

	  https://github.com/googlefonts/noto-emoji
```

## package/sherpa-onnx/Config.in
```kconfig
config BR2_PACKAGE_SHERPA_ONNX
	bool "sherpa-onnx"
	depends on BR2_x86_64
	depends on BR2_TOOLCHAIN_USES_GLIBC
	depends on BR2_INSTALL_LIBSTDCPP
	help
	  Local neural voice (Piper/VITS models) for reading aloud:
	  sherpa-onnx-offline-tts with its onnxruntime, in /opt/sherpa-onnx.
	  Official release binary (like sof-bin): building it here would
	  download a prebuilt onnxruntime mid-build anyway.
	  scripts/download-model.sh puts the voices in models/piper.

	  https://github.com/k2-fsa/sherpa-onnx
```

## package/sof-bin/Config.in
```kconfig
config BR2_PACKAGE_SOF_BIN
	bool "sof-bin"
	help
	  Sound Open Firmware (SOF) firmware and topologies for the Intel
	  audio DSP (Ice Lake and later, and the digital microphones of
	  almost every current Intel laptop). Binaries signed by Intel.

	  https://github.com/thesofproject/sof-bin
```

## package/swayidle/Config.in
```kconfig
config BR2_PACKAGE_SWAYIDLE
	bool "swayidle"
	depends on BR2_PACKAGE_WAYLAND
	depends on BR2_PACKAGE_SYSTEMD
	select BR2_PACKAGE_WAYLAND_PROTOCOLS
	help
	  Actions on idle (lock, turn the screen off) and before suspend
	  (lid closed), via logind.

	  https://github.com/swaywm/swayidle
```

## package/swaylock/Config.in
```kconfig
config BR2_PACKAGE_SWAYLOCK
	bool "swaylock"
	depends on BR2_PACKAGE_WAYLAND
	depends on BR2_PACKAGE_LINUX_PAM
	select BR2_PACKAGE_CAIRO
	select BR2_PACKAGE_LIBXKBCOMMON
	select BR2_PACKAGE_WAYLAND_PROTOCOLS
	help
	  Screen lock for sway (with PAM: the user's password).

	  https://github.com/swaywm/swaylock
```

## package/whisper-cpp/Config.in
```kconfig
config BR2_PACKAGE_WHISPER_CPP
	bool "whisper-cpp"
	depends on BR2_INSTALL_LIBSTDCPP
	depends on BR2_TOOLCHAIN_HAS_THREADS
	help
	  Local speech recognition (Whisper) on the CPU. Goes in /opt/whisper
	  with its own ggml: llama.cpp's is a different version and the
	  libggml*.so libraries would clash in /usr/lib.

	  https://github.com/ggml-org/whisper.cpp
```

## package/wl-clipboard/Config.in
```kconfig
config BR2_PACKAGE_WL_CLIPBOARD
	bool "wl-clipboard"
	depends on BR2_PACKAGE_WAYLAND
	select BR2_PACKAGE_WAYLAND_PROTOCOLS
	help
	  wl-copy and wl-paste: the Wayland clipboard. Used by the agent's
	  'clipboard' tool ("summarize what I copied").

	  https://github.com/bugaevc/wl-clipboard
```

## package/wl-mirror/Config.in
```kconfig
config BR2_PACKAGE_WL_MIRROR
	bool "wl-mirror"
	depends on BR2_PACKAGE_WAYLAND
	depends on BR2_PACKAGE_MESA3D_OPENGL_EGL
	depends on BR2_PACKAGE_MESA3D_OPENGL_ES
	select BR2_PACKAGE_WAYLAND_PROTOCOLS
	help
	  Mirror one display onto another (sway does not do it by itself).
	  Used by 'osyr ui display mirror'.

	  https://github.com/Ferdi265/wl-mirror
```

## package/wtype/Config.in
```kconfig
config BR2_PACKAGE_WTYPE
	bool "wtype"
	depends on BR2_PACKAGE_WAYLAND
	select BR2_PACKAGE_LIBXKBCOMMON
	help
	  Types text into the focused window, like a virtual keyboard
	  (wlroots virtual-keyboard protocol). Used by OSYR dictation
	  (osyr-voice dictate).

	  https://github.com/atx/wtype
```
